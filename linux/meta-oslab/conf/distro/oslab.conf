## linux/meta-oslab/conf/distro/oslab.conf
```bitbake
require conf/distro/poky.conf

DISTRO = "oslab"
DISTRO_NAME = "os-lab"

INIT_MANAGER = "systemd"
```

## linux/meta-oslab/conf/layer.conf
```bitbake
BBPATH .= ":${LAYERDIR}"

BBFILES += "${LAYERDIR}/recipes-*/*/*.bb ${LAYERDIR}/recipes-*/*/*.bbappend"

BBFILE_COLLECTIONS += "oslab"
BBFILE_PATTERN_oslab = "^${LAYERDIR}/"
BBFILE_PRIORITY_oslab = "6"

LAYERDEPENDS_oslab = "core"
LAYERSERIES_COMPAT_oslab = "wrynose"
```
